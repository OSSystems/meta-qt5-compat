## conf/layer.conf
```bitbake
BBPATH .= ":${LAYERDIR}"

BBFILES += "${LAYERDIR}/recipes-*/*/*.bb ${LAYERDIR}/recipes-*/*/*.bbappend"
BBFILE_COLLECTIONS += "qt5-compat-layer"
BBFILE_PATTERN_qt5-compat-layer := "^${LAYERDIR}/"
BBFILE_PRIORITY_qt5-compat-layer = "9"

LAYERVERSION_qt5-compat-layer = "1"
LAYERDEPENDS_qt5-compat-layer = "core qt5-layer"
LAYERSERIES_COMPAT_qt5-compat-layer = "rocko"


## Qt5 fixups
LAYERSERIES_COMPAT_qt5-layer_append = " rocko"
```
